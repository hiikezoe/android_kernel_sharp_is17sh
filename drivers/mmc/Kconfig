## drivers/mmc/Kconfig
```kconfig
#
# MMC subsystem configuration
#

menuconfig MMC
	tristate "MMC/SD/SDIO card support"
	depends on HAS_IOMEM
	help
	  This selects MultiMediaCard, Secure Digital and Secure
	  Digital I/O support.

	  If you want MMC/SD/SDIO support, you should say Y here and
	  also to your specific host controller driver.

config MMC_DEBUG
	bool "MMC debugging"
	depends on MMC != n
	help
	  This is an option for use by developers; most people should
	  say N here.  This enables MMC core and driver debugging.

config MMC_PERF_PROFILING
	bool "MMC performance profiling"
	depends on MMC != n
	default n
	help
	  If you say Y here, support will be added for collecting
	  performance numbers at the MMC Queue and Host layers.

config SHSD_DRIVER
	bool "SHARP SD driver"
	default n

config MMC_CUST_SH
	bool "SHARP MMC driver customized"
	depends on MMC
	default n

config MMC_EMMC_CUST_SH
	bool "SHARP eMMC driver customized"
	depends on MMC_CUST_SH && MMC_MSM_SDC2_SUPPORT
	default n

config RW_PROTECT_EMMC_CUST_SH
	bool "SHARP MMC read/write protect customized"
	depends on MMC_EMMC_CUST_SH
	default n

config ERR_RETRY_EMMC_CUST_SH
	bool "SHARP MMC error retry customized"
	depends on MMC_EMMC_CUST_SH
	default n

config ACCESS_OPTIMIZE_EMMC_CUST_SH
	bool "SHARP MMC access optimization customized"
	depends on MMC_EMMC_CUST_SH
	default n

config TIMEOUTCTRL_EMMC_CUST_SH
	bool "SHARP MMC timeout control customized"
	depends on MMC_EMMC_CUST_SH
	default n

config IDLECTRL_EMMC_CUST_SH
	bool "SHARP MMC idle control customized"
	depends on MMC_EMMC_CUST_SH
	default n

config DELAY_EMMC_CUST_SH
	bool "SHARP MMC raise the precision of delay customized"
	depends on MMC_EMMC_CUST_SH
	default n

config MMC_SDIO_CUST_SH
	bool "SHARP SDIO driver customized"
	depends on MMC_CUST_SH
	default n



if MMC

source "drivers/mmc/core/Kconfig"

source "drivers/mmc/card/Kconfig"

source "drivers/mmc/host/Kconfig"

endif # MMC
```

## drivers/sharp/Kconfig
```kconfig
#
# SHARP configuration
#

menu "SHARP Device Drivers"

source "drivers/sharp/shirpm/Kconfig"

source "drivers/sharp/wifi/Kconfig"

source "drivers/sharp/shextdet/Kconfig"

source "drivers/sharp/mfc/Kconfig"

source "drivers/sharp/shdiag/Kconfig"

source "drivers/sharp/presenter/Kconfig"

source "drivers/sharp/light_inpdev/Kconfig"

source "drivers/sharp/btpm/Kconfig"

source "drivers/sharp/shkeyled/Kconfig"

source "drivers/sharp/proximity/Kconfig"

#source "drivers/sharp/shsupport/Kconfig"

source "drivers/sharp/bthid/Kconfig"

source "drivers/sharp/tunerdrv/Kconfig"

source "drivers/sharp/tunerdrv_af33/Kconfig"

source "drivers/sharp/audio/Kconfig"

#source "drivers/sharp/shmds/ami602/Kconfig"

source "drivers/sharp/shmds/ami603/Kconfig"

#source "drivers/sharp/shmds/mpu3050/Kconfig"

source "drivers/sharp/shmds/yas530/Kconfig"

source "drivers/sharp/shrmts/Kconfig"

source "drivers/sharp/vold/Kconfig"

source "drivers/sharp/shgeiger/Kconfig"

source "drivers/sharp/shusb/Kconfig"

endmenu
```

## drivers/sharp/audio/Kconfig
```kconfig
#
# audio device configuration
#
# CONFIG_SH_AUDIO_DRIVER newly created

menu "SHARP audio driver"

comment "SHARP audio drivers"

config SH_AUDIO_DRIVER
	tristate "SHARP Audio Driver customized"
	default y

config SH_AUDIO_DRIVER_MODEL_NUMBER
	int "SH_AUDIO_DRIVER_MODEL_NUMBER"
	range 0 999
	default "0"

config SHSPAMP_AK7833
	tristate "SHARP spamp ak7833"
	default y

config SHSPAMP_AN12969
	tristate "SHARP spamp an12969"
	default n

config SHSPAMP_AK7811
	tristate "SHARP spamp ak7811"
	default n

config SHVIBRATOR_LINEAR
	tristate "SHARP vibrator LINEAR"
	default n

config SHVIBRATOR
	tristate "SHARP vibrator"
	default y

config SHHPAMP_WM8918
	tristate "SHARP WM8918 driver"
	default n

endmenu
```

## drivers/sharp/bthid/Kconfig
```kconfig
#
# Broadcom BtHid device configuration
#

menu "Bluetooth Hid driver"

config BROADCOM_BTHID_DRIVER
	bool "Broadcom BtHid driver"
	default y
	help
	  Enable Broadcom BtHid device driver.

endmenu
```

## drivers/sharp/btpm/Kconfig
```kconfig
# drivers/sharp/btpm/Kconfig

menu "BT Configuration"

config BTPM
	bool "BT Power Management Support"
	default y
	help
	  Power management implementation for BT Functionality.

endmenu
```

## drivers/sharp/light_inpdev/Kconfig
```kconfig
#
# SHLightSensor input device configuration
#

menu "SHLightSensor driver"

comment "SHARP Light Sensor input device"

config SHSENSORS_LIGHT
	bool "SHLightSensor input device"
	default y
	help
	  SHLightSensor Support.

endmenu
```

## drivers/sharp/mfc/Kconfig
```kconfig
#
# FeliCa device configuration
#

menu "FeliCa driver"

comment "SHARP FeliCa device drivers"

config SHFELICA
	bool "FeliCa device drivers"
	default n
	help
	  Enable FeliCa driver.

endmenu
```

## drivers/sharp/proximity/Kconfig
```kconfig
#
# Proximity device configuration
#
# drivers/sharp/proximity/Kconfig

menu "Proximity Configuration"

config SENSORS_PROXIMITY
	tristate "Proximity Sensor Driver"
	depends on I2C
    default n

config PROXIMITY_IRQ_SETTING
	int "PROXIMITY IRQ Setting"
	depends on SENSORS_PROXIMITY
	range 0 4
	default "4"

config PROXIMITY_SENSITIVITY_SETTING
	int "PROXIMITY Sensitivity Setting"
	depends on SENSORS_PROXIMITY
	range 0 3
	default "3"

config PROXIMITY_POWER_SUPPLY_SETTING
	int "PROXIMITY Power Supply Setting"
	depends on SENSORS_PROXIMITY
	range 0 2
	default "2"

config PROXIMITY_WAKESW
	bool "Proximity WAKESW"
	depends on SENSORS_PROXIMITY
	default n

endmenu
```

## drivers/sharp/shextdet/Kconfig
```kconfig
# drivers/sharp/shextdet/Kconfig

menu "SHARP ExtDev Device Drivers"

config SHEXTDEV
	bool "SHARP ExtDev Device Drivers"
	depends on MSM_RPCSERVER_HANDSET
	default y

config SHEXTDEV_FLIP
	bool "SHARP ExtDev Flip Device Drivers"
	depends on MSM_RPCSERVER_HANDSET

config SHEXTDEV_SWIVEL
	bool "SHARP ExtDev Swivel Device Drivers"
	depends on MSM_RPCSERVER_HANDSET

config SHEXTDEV_SIDE_POWERKEY
	bool "SHARP ExtDev SidePowerKey Device Driver"

config USB_SWIC
	bool "USB switch IC Driver"

endmenu
```

## drivers/sharp/shgeiger/Kconfig
```kconfig
#
# Shgeiger device configuration
#
# drivers/sharp/shgeiger/Kconfig

menu "Shgeiger Configuration"

config SENSORS_SHGEIGER
	tristate "Shgeiger Sensor Driver"
	depends on I2C

endmenu
```

## drivers/sharp/shirpm/Kconfig
```kconfig
menu "SHARP Infrared drivers"

config SHIRDA
	bool "SHARP IrDA SIR/FIR driver"
	default y
	select SHIRPM

config SHIRRC
	bool "SHARP IrRemoteControl driver"
	default y
	select SHIRPM

config SHIRPM
	depends on SHIRDA || SHIRRC
	bool "Infrared Power Management Support"
	default y

config SHIRPM_CTRL_LED_VCC
	depends on SHIRPM
	bool "Control IrDA Transceiver Power"
	default n

choice
	bool "SHARP Infrared Device"
	default SHARP_INFRARED_LR388J5
	depends on SHIRDA || SHIRRC

config SHARP_INFRARED_LR388G7
	bool "LR388G7"

config SHARP_INFRARED_LR388J5
	bool "LR388J5"

endchoice

endmenu
```

## drivers/sharp/shkeyled/Kconfig
```kconfig
# drivers/sharp/shkeyled/Kconfig

menu "SHARP KEYLED Device Drivers"

config LEDS_KEY_LED
	bool "SHARP KEYLED Device Drivers"

config LEDS_KEY_LED_PORT
	int "SHARP KEYLED Device Port"
	depends on LEDS_KEY_LED
	default "0"
	help
	  KeyLED Port Setting.
	    0: High current and Low current
	    1: Low current
	    2: LED_KEYPAD

config LEDS_KEY_KEYBOARDLED
	bool "SHARP KEYLED keyboard Device"
	depends on LEDS_KEY_LED
	default n

endmenu
```

## drivers/sharp/shmds/ami603/Kconfig
```kconfig
menu "AMI603 MDS DRIVER"

config SENSORS_AMI603
	tristate "AMI603 sensor"
	default n

config SENSORS_AMI603_FLIP
	tristate "AMI603 FLIP"
	default n

endmenu
```

## drivers/sharp/shmds/yas530/Kconfig
```kconfig
config SH_YAS530
	bool "SHARP compass Device Drivers"
	depends on I2C

config SH_YAS530_POSITION
	int "YAS530 Mounting Position on Board"
	depends on SH_YAS530
	default "0"
	help
	  Chip mounting position (pin 1).
	    0: top, upper-left
	    1: top, upper-right
	    2: top, lower-right
	    3: top, lower-left
	    4: bottom, upper-left
	    5: bottom, upper-right
	    6: bottom, lower-right
	    7: bottom, lower-left

config SH_YAS530_ORIENTATION
	bool "YAS Orientation Sensor"
	depends on SH_YAS530

config SH_YAS530_ACCELEROMTER
	tristate "YAS Acceleration Sensor"
	depends on SH_YAS530

config SH_YAS530_ACCELEROMETER_POSITION
	int "YAS Acceleration Sensor Mounting Position on Board"
	depends on SH_YAS530_ACCELEROMTER
	default "0"
	help
	  Chip mounting position (pin 1).
	    0: top, upper-left
	    1: top, upper-right
	    2: top, lower-right
	    3: top, lower-left
	    4: bottom, upper-left
	    5: bottom, upper-right
	    6: bottom, lower-right
	    7: bottom, lower-left
```

## drivers/sharp/shrmts/Kconfig
```kconfig
#
# SHRMTS device configuration
#

menu "SHRMTS driver"

comment "SHARP RMTS drivers"

config SHRMTS
	bool "SHRMTS drivers"
	default y
	help
	  Enable SHRMTS.

endmenu
```

## drivers/sharp/shsupport/Kconfig
```kconfig
#
# shsupport device configuration
#

comment "for supporttool"

config SHSUPPORT_CUST
	bool "SH SUPPORT TOOL"
	default y
```

## drivers/sharp/shtps/Kconfig
```kconfig
#
# Sharp Touchscreen configuration
#

menuconfig TOUCHSCREEN_SHTPS
	bool "sharp touchscreens"
	default y

if TOUCHSCREEN_SHTPS

	config SHTPS_SY3000_TM1836_001
		tristate "SY3000 TM1836-001"
		default n
		depends on TOUCHSCREEN_SHTPS

	if SHTPS_SY3000_TM1836_001
		source "drivers/sharp/shtps/sy3000/tm1836-001/Kconfig"
	endif # SHTPS_SY3000_TM1836_001

	config SHTPS_SY3000_TM1901_001
		tristate "SY3000 TM1901_001"
		default n
		depends on TOUCHSCREEN_SHTPS

	if SHTPS_SY3000_TM1901_001
		source "drivers/sharp/shtps/sy3000/tm1901-001/Kconfig"
	endif # SHTPS_SY3000_TM1901_001

	config SHTPS_SY3000_TM1918_001
		tristate "SY3000 TM1918_001"
		default n
		depends on TOUCHSCREEN_SHTPS

	if SHTPS_SY3000_TM1918_001
		source "drivers/sharp/shtps/sy3000/tm1918-001/Kconfig"
	endif # SHTPS_SY3000_TM1918_001

	config SHTPS_SY3000_TM1963_001
		tristate "SY3000 TM1963_001"
		default n
		depends on TOUCHSCREEN_SHTPS

	if SHTPS_SY3000_TM1963_001
		source "drivers/sharp/shtps/sy3000/tm1963-001/Kconfig"
	endif # SHTPS_SY3000_TM1963_001

	config SHTPS_SY3000_TM1980_001
		tristate "SY3000 TM1980_001"
		default n
		depends on TOUCHSCREEN_SHTPS

	if SHTPS_SY3000_TM1980_001
		source "drivers/sharp/shtps/sy3000/tm1980-001/Kconfig"
	endif # SHTPS_SY3000_TM1980_001

	config SHTPS_SY3000_TM2153_001
		tristate "SY3000 TM2153_001"
		default n
		depends on TOUCHSCREEN_SHTPS

	if SHTPS_SY3000_TM2153_001
		source "drivers/sharp/shtps/sy3000/tm2153-001/Kconfig"
	endif # SHTPS_SY3000_TM2153_001

	config SHTPS_SY3000_TM2179_001
		tristate "SY3000 TM2179_001"
		default n
		depends on TOUCHSCREEN_SHTPS

	if SHTPS_SY3000_TM2179_001
		source "drivers/sharp/shtps/sy3000/tm2179-001/Kconfig"
	endif # SHTPS_SY3000_TM2179_001

	config SHTPS_SY3000_TM2225_001
		tristate "SY3000 TM2225_001"
		default n
		depends on TOUCHSCREEN_SHTPS

	if SHTPS_SY3000_TM2225_001
		source "drivers/sharp/shtps/sy3000/tm2225-001/Kconfig"
	endif # SHTPS_SY3000_TM2225_001

	config SHTPS_TMA3XX_TMA340_003
		tristate "TMA3XX TMA340-003"
		default n
		depends on TOUCHSCREEN_SHTPS

	if SHTPS_TMA3XX_TMA340_003
		source "drivers/sharp/shtps/tma3xx/tma340-003/Kconfig"
	endif # SHTPS_TMA3XX_TMA340_003

	config SHTPS_TMA3XX_TMA340_004
		tristate "TMA3XX TMA340-004"
		default n
		depends on TOUCHSCREEN_SHTPS

	if SHTPS_TMA3XX_TMA340_004
		source "drivers/sharp/shtps/tma3xx/tma340-004/Kconfig"
	endif # SHTPS_TMA3XX_TMA340_004

	config SHTPS_TMA3XX_TMA340_005
		tristate "TMA3XX TMA340-005"
		default n
		depends on TOUCHSCREEN_SHTPS

	if SHTPS_TMA3XX_TMA340_005
		source "drivers/sharp/shtps/tma3xx/tma340-005/Kconfig"
	endif # SHTPS_TMA3XX_TMA340_005

endif # TOUCHSCREEN_SHTPS
```

## drivers/sharp/shtps/sy3000/tm1901-001/Kconfig
```kconfig
#
# Sharp Touchscreen tm1901-001 configuration
#

config SHTPS_SY3000_LCD_SIZE_X
	int "SHTPS_SY3000_LCD_SIZE_X"
	range 0 9999
	default "0"
	depends on SHTPS_SY3000_TM1901_001

config SHTPS_SY3000_LCD_SIZE_Y
	int "SHTPS_SY3000_LCD_SIZE_Y"
	range 0 9999
	default "0"
	depends on SHTPS_SY3000_TM1901_001

config SHTPS_SY3000_PANEL_SIZE_X
	int "SHTPS_SY3000_PANEL_SIZE_X"
	range 0 9999
	default "0"
	depends on SHTPS_SY3000_TM1901_001

config SHTPS_SY3000_PANEL_SIZE_Y
	int "SHTPS_SY3000_PANEL_SIZE_Y"
	range 0 9999
	default "0"
	depends on SHTPS_SY3000_TM1901_001

config SHTPS_SY3000_FACETOUCH_DETECT
	bool "SHTPS_SY3000_FACETOUCH_DETECT"
	default n
	depends on SHTPS_SY3000_TM1901_001

config SHTPS_SY3000_FACETOUCH_OFF_DETECT
	bool "SHTPS_SY3000_FACETOUCH_OFF_DETECT"
	default n
	depends on SHTPS_SY3000_TM1901_001

config SHTPS_SY3000_POSITION_OFFSET
	bool "SHTPS_SY3000_POSITION_OFFSET"
	default n
	depends on SHTPS_SY3000_TM1901_001

config SHTPS_SY3000_VIRTUAL_KEY
	bool "SHTPS_SY3000_VIRTUAL_KEY"
	default n
	depends on SHTPS_SY3000_TM1901_001

config SHTPS_SY3000_ALWAYS_ACTIVEMODE
	bool "SHTPS_SY3000_ALWAYS_ACTIVEMODE"
	default n
	depends on SHTPS_SY3000_TM1901_001

config SHTPS_SY3000_AUTOREZERO_CONTROL
	bool "SHTPS_SY3000_AUTOREZERO_CONTROL"
	default n
	depends on SHTPS_SY3000_TM1901_001

config SHTPS_SY3000_FLIP_CHANGE_HANDLE
	bool "SHTPS_SY3000_FLIP_CHANGE_HANDLE"
	default n
	depends on SHTPS_SY3000_TM1901_001

config SHTPS_SY3000_SINGLE_1ST_DRSTEP
	int "SHTPS_SY3000_SINGLE_1ST_DRSTEP"
	range 0 999
	default "4"
	depends on SHTPS_SY3000_TM1901_001

config SHTPS_SY3000_SINGLE_2ND_DRSTEP
	int "SHTPS_SY3000_SINGLE_2ND_DRSTEP"
	range 0 999
	default "1"
	depends on SHTPS_SY3000_TM1901_001

config SHTPS_SY3000_MULTI_1ST_DRSTEP
	int "SHTPS_SY3000_MULTI_1ST_DRSTEP"
	range 0 999
	default "8"
	depends on SHTPS_SY3000_TM1901_001

config SHTPS_SY3000_MULTI_2ND_DRSTEP
	int "SHTPS_SY3000_MULTI_2ND_DRSTEP"
	range 0 999
	default "1"
	depends on SHTPS_SY3000_TM1901_001
```

## drivers/sharp/shtps/tma3xx/tma340-003/Kconfig
```kconfig
#
# Sharp Touchscreen tma340-003 configuration
#

config SHTPS_TMA3XX_FACETOUCH_DETECT
	bool "SHTPS_TMA3XX_FACETOUCH_DETECT"
	default n
	depends on SHTPS_TMA3XX_TMA340_003

config SHTPS_TMA3XX_FACETOUCH_OFF_DETECT
	bool "SHTPS_TMA3XX_FACETOUCH_OFF_DETECT"
	default n
	depends on SHTPS_TMA3XX_TMA340_003

config SHTPS_TMA3XX_VIRTUAL_KEY
	bool "SHTPS_TMA3XX_VIRTUAL_KEY"
	default n
	depends on SHTPS_TMA3XX_TMA340_003

config SHTPS_TMA3XX_VIRTUAL_KEY_MENU
	string "SHTPS_TMA3XX_VIRTUAL_KEY_MENU"
	default ":0:0:0:0"
	depends on SHTPS_TMA3XX_TMA340_003 && SHTPS_TMA3XX_VIRTUAL_KEY

config SHTPS_TMA3XX_VIRTUAL_KEY_HOME
	string "SHTPS_TMA3XX_VIRTUAL_KEY_HOME"
	default ":0:0:0:0"
	depends on SHTPS_TMA3XX_TMA340_003 && SHTPS_TMA3XX_VIRTUAL_KEY

config SHTPS_TMA3XX_VIRTUAL_KEY_BACK
	string "SHTPS_TMA3XX_VIRTUAL_KEY_BACK"
	default ":0:0:0:0"
	depends on SHTPS_TMA3XX_TMA340_003 && SHTPS_TMA3XX_VIRTUAL_KEY
```

## drivers/sharp/shtps/tma3xx/tma340-005/Kconfig
```kconfig
#
# Sharp Touchscreen tma340-005 configuration
#

config SHTPS_TMA3XX_FACETOUCH_DETECT
	bool "SHTPS_TMA3XX_FACETOUCH_DETECT"
	default n
	depends on SHTPS_TMA3XX_TMA340_005

config SHTPS_TMA3XX_FACETOUCH_OFF_DETECT
	bool "SHTPS_TMA3XX_FACETOUCH_OFF_DETECT"
	default n
	depends on SHTPS_TMA3XX_TMA340_005

config SHTPS_TMA3XX_VIRTUAL_KEY
	bool "SHTPS_TMA3XX_VIRTUAL_KEY"
	default n
	depends on SHTPS_TMA3XX_TMA340_005

config SHTPS_TMA3XX_VIRTUAL_KEY_MENU
	string "SHTPS_TMA3XX_VIRTUAL_KEY_MENU"
	default ":0:0:0:0"
	depends on SHTPS_TMA3XX_TMA340_005 && SHTPS_TMA3XX_VIRTUAL_KEY

config SHTPS_TMA3XX_VIRTUAL_KEY_HOME
	string "SHTPS_TMA3XX_VIRTUAL_KEY_HOME"
	default ":0:0:0:0"
	depends on SHTPS_TMA3XX_TMA340_005 && SHTPS_TMA3XX_VIRTUAL_KEY

config SHTPS_TMA3XX_VIRTUAL_KEY_BACK
	string "SHTPS_TMA3XX_VIRTUAL_KEY_BACK"
	default ":0:0:0:0"
	depends on SHTPS_TMA3XX_TMA340_005 && SHTPS_TMA3XX_VIRTUAL_KEY

config SHTPS_TMA3XX_VIRTUAL_KEY_SEARCH
	string "SHTPS_TMA3XX_VIRTUAL_KEY_SEARCH"
	default ":0:0:0:0"
	depends on SHTPS_TMA3XX_TMA340_005 && SHTPS_TMA3XX_VIRTUAL_KEY
```
